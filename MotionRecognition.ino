#include "Wire.h"
#include <SPI.h>
#include <RF24.h>
#include <nRF24L01.h>
#include <RF24_config.h>

int led = 3;                             // PIN OUTPUT LED
RF24 radio(9,10);                        // CE & CSN
const uint64_t address = 0xE8E8F0F0E1LL; //ALAMAT RADIO
int16_t kirim[6][3];                     // array untuk data yang diterima dari perangkat pengirim
int K = 12;                               // Nilai K untuk klasifikasi
int16_t mode[3];

/*    DATA TRAINING   */
int16_t DT[30][6][3]={
  //data 1 Melambai kebawah (mati)
    {{17912, 6928,  -10852},{16688,  6340,  -16468},{10588,  3472,  -15944},{-27208,  -1912, 8072},{-32768, -5524, 19264},{1,0,0}},
    {{18028, 11360, -21112},{11612,  6568,  -19640},{1356 , 1056,  -9056},{-27700,  -7056, 5028},{-15344, -2864, -64},{1,0,0}},
    {{18080, 6584,  -20496},{11436,  4796,  -15792},{4272,  332, -908},{-16500, 580, 15708},{-15444,  -5428, 22964},{1,0,0}},
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    {{16544, 4788,  -20416},{7420,  1848,  -11508},{644, 1756,  1936},{-4740,  -5316, 18708},{-5432, -7356, 25356},{1,0,0}},
  //data 2 Melambai ke kiri (meredup)
    {{2136,  28280, 5636},{484, 25364, 8588},{2028,  14696, 4976},{-7708, -30488,  -6072},{-6168, -15800,  -3764},{2,0,0}},
    {{-12076,  -6228, 28084},{-10212,  -6060, 22236},{-4596,  -5992, 11264},{3632, -2356, -30396},{1368, -2660, -20492},{2,0,0}},
    {{948,  23488, 11564},{3044, 17700, 10396},{2140,  7016 , 5796},{3256, -10000,  -2456},{396,  -32768,  208},{2,0,0}},
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    {{-4088,  3000,  24424},{-3812, 1912,  22540},{1340, 164, 11492},{-416,  -5332, -23192},{-3824, -7356, -28188},{2,0,0}},
  //data 3 Melambai ke atas (nyala)
    {{-14504,  652, -2396},{-19592,  -2448, 4728},{-30128, -2300, 8480},{-1592, -664,  -4084},{8900, 4576,  -10636},{3,0,0}},
    {{-17500,  -4244, 2352},{-30540, -10156,  9040},{-32768, -8348, 6920},{2844, 1240,  -3460},{10584,  3168,  -6208},{3,0,0}},
    {{-14120,  1564,  -2208},{-26048,  -8420, 10068},{-32768,  -5088, 5732},{15708, 6580,  -10316},{18416,  9300,  -9280},{3,0,0}},
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    {{32,  -212,  -18844},{2496, 1556,  -30060},{2564, 1280,  -31112},{11792, -2184, 11132},{11644, -624,  12132},{3,0,0}}    
};

void setup() {
  Serial.begin(115200);
  SPI.begin();
  pinMode(led, OUTPUT);
  radio.begin();
  radio.openReadingPipe(1, address);
  radio.startListening();
  Serial.println("Stand By");
  
}

void loop() {
  if(radio.available())
  {
    unsigned long first = 0;
    first = millis();
    delay(30);
    radio.read(&kirim , sizeof(kirim)); //paket data yang diterima
    Serial.println("Paket yang diterima");
    for(int z = 0; z<5 ; z++)
    {
      Serial.print(z+1); Serial.print("\t");
      Serial.print(kirim[z][0]); Serial.print("\t");
      Serial.print(kirim[z][1]); Serial.print("\t");
      Serial.println(kirim[z][2]);
    }
    Serial.println(" ");
    klasifikasi(kirim,DT);
    ulang(DT);
    unsigned long  last = millis();
    unsigned long  hasil = (last - first); 
    Serial.print(hasil); Serial.println(" miliseconds");
  }   
}

void klasifikasi(int16_t kirim[6][3],int16_t DT[15][6][3]){
  int16_t d, d1;
  Serial.println("Eudlidean Distance : ");
  for (int a = 0; a < 30 ; a++ ){
    for( int b = 0 ; b < 5 ; b++){
       d = sqrt(abs(pow((DT[a][b][0] - kirim[b][0]),2)) + abs(pow((DT[a][b][1] - kirim[b][1]),2)) + abs(pow((DT[a][b][2] - kirim[b][2]),2)));
       d1 = abs(d);    
    }
    DT[a][5][1] = d1;
    Serial.print(a+1); Serial.print("\t");Serial.println(DT[a][5][1]); 
    
    //reset variabel
    d = d1 = 0;
  } 
  Serial.println("");
  sorting(DT);
}

int sorting(int16_t DT[15][6][3]){
  int16_t tmp[3];
  Serial.println("data setelah diurutkan");
  //mengurutkan 
  for (int a = 0; a < 30 ; a++){
    for (int b = a+1; b < 30; b++){
       if (DT[a][5][1]>DT[b][5][1]){
        tmp[0] = DT[a][5][0]; tmp[1] = DT[a][5][1];  tmp[2] = DT[a][5][2];
        DT[a][5][0] = DT[b][5][0]; DT[a][5][1] = DT[b][5][1]; DT[a][5][2] = DT[b][5][2];
        DT[b][5][0] = tmp[0]; DT[b][5][1] = tmp[1]; DT[b][5][2] = tmp[2];
       }
    }
    Serial.print(a+1); Serial.print("\t");
    Serial.print(DT[a][5][1]); Serial.print("\t");
    Serial.println(DT[a][5][0]);
  }

  //MODULUS 
  int hitung = 1, hitung2 = 1;
  for (int c = 0; c<K; c++){
    for(int d = c+1 ; d<K ; d++){
      if (DT[c][5][0] == DT[d][5][0]){
        hitung++;
      } else {
        if (hitung > hitung2){
           hitung2 = hitung;
           mode[0] = DT[c][5][0]; mode[1] = DT[c][5][1]; mode[2] = DT[c][5][2];
        }
        hitung = 1;
      }
    } 
  }
  lampu();
};

//KONDISI LAMPU
void lampu(){
  if (mode[0] == 1){ //mati
    analogWrite(led, 0);
  }
  else if (mode[0] == 2) { //redup
    analogWrite(led, 50);
  }
  else if (mode[0] == 3) { //nyala
    analogWrite(led, 255);
  }
  Serial.println("  ");
  Serial.print("mode = ");Serial.println(mode[0]);
}

//reset label data training
void ulang(int16_t DT[30][6][3] ){
  for(int a = 0; a<30 ; a++){
    if (a<10){
      DT[a][5][0] = 1;
    } else if (a>9 && a<19){
      DT[a][5][0] = 2;
    } else if (a>19){
      DT[a][5][0] = 3;
    }
    DT[a][5][1] = 0;
    DT[a][5][2] = 0;
  }
 }

